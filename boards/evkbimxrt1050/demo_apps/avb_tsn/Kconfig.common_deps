## boards/evkbimxrt1050/demo_apps/avb_tsn/Kconfig.common_deps
```kconfig
config MCUX_PRJSEG_module.board.evkbimxrt1050
    bool
    default y
    select MCUX_COMPONENT_component.igpio_adapter
    select MCUX_COMPONENT_component.phyksz8081
    select MCUX_COMPONENT_component.rtos_apps.async
    select MCUX_COMPONENT_driver.flexspi
    select MCUX_COMPONENT_driver.enet
    select MCUX_COMPONENT_driver.snvs_hp
    select MCUX_COMPONENT_driver.semc
```

## boards/evkbmimxrt1170/demo_apps/avb_tsn/Kconfig.common_deps
```kconfig
config MCUX_PRJSEG_module.board.evkbmimxrt1170
    bool
    default y
    select APP_LWIP
    select APP_STORAGE
    select MCUX_COMPONENT_component.phyrtl8211f
    select MCUX_COMPONENT_component.rtos_apps.async
    select MCUX_COMPONENT_component.igpio_adapter
    select MCUX_COMPONENT_driver.flexspi
    select MCUX_COMPONENT_driver.enet_qos
    select MCUX_COMPONENT_driver.enet
    select MCUX_COMPONENT_driver.snvs_hp
```

## boards/evkbmimxrt1170/demo_apps/avb_tsn/tsn_app/cm7/Kconfig
```kconfig
# Copyright 2025 NXP
#
# SPDX-License-Identifier: BSD-3-Clause

config MCUX_PRJSEG_config.board.tsn
    bool "MIMXRT1170 EVKB TSN endpoint configuration"
    default y
    select APP_TSN_ENDPOINT
    select APP_USER_BUTTON
    select APP_QBV
    select APP_FP
    select MCUX_COMPONENT_middleware.genavb.srp
    select MCUX_COMPONENT_driver.semc

config MCUX_PRJSEG_config.board.tsn_motor_controller
    bool "MIMXRT1170 EVKB TSN Motor Controller configuration"
    default n
    select APP_MOTOR_CONTROLLER

config MCUX_PRJSEG_config.board.tsn_motor_iodevice
    bool "MIMXRT1170 EVKB TSN Motor IO-device configuration"
    default n
    select APP_MOTOR_IO_DEVICE
```

## boards/evkmimxrt1180/demo_apps/avb_tsn/Kconfig.common_deps
```kconfig
config MCUX_PRJSEG_module.board.evkmimxrt1180
    bool
    default y
    select MCUX_COMPONENT_component.phyrtl8201
    select MCUX_COMPONENT_component.phyrtl8211f
    select MCUX_COMPONENT_driver.msgintr
    select MCUX_COMPONENT_driver.netc
    select MCUX_COMPONENT_driver.netc_switch
    select MCUX_COMPONENT_driver.rgpio
    select MCUX_COMPONENT_driver.trdc
    select MCUX_COMPONENT_driver.flexspi
    select MCUX_COMPONENT_component.rtos_apps.async
```

## boards/evkmimxrt1180/demo_apps/avb_tsn/tsn_app/cm33/Kconfig
```kconfig
# Copyright 2025-2026 NXP
#
# SPDX-License-Identifier: BSD-3-Clause

choice MCUX_PRJSEG_config.board.build_cfg_sel
    prompt "MIMXRT1180 EVK CM33 TSN build configuration options"
    default MCUX_PRJSEG_config.board.app_bridge_default

    config MCUX_PRJSEG_config.board.app_bridge_default
        bool "TSN bridge default configuration"
        select APP_TSN_BRIDGE
        select APP_STORAGE
        imply APP_QBV
        imply APP_FP
        imply APP_LWIP
        select MCUX_COMPONENT_driver.cache_xcache
        select MCUX_COMPONENT_middleware.freertos-kernel.cm33_non_trustzone
        imply MCUX_COMPONENT_middleware.genavb.srp
        imply MCUX_COMPONENT_middleware.genavb.hsr
        select MCUX_COMPONENT_component.rtos_apps.tsn_headers

    config MCUX_PRJSEG_config.board.app_bridge_no_enetc0
        bool "TSN bridge disable ENETC0 configuration"
        select APP_TSN_BRIDGE
        select APP_STORAGE
        imply APP_QBV
        imply APP_FP
        imply APP_LWIP
        select MCUX_COMPONENT_driver.cache_xcache
        select MCUX_COMPONENT_middleware.freertos-kernel.cm33_non_trustzone
        imply MCUX_COMPONENT_middleware.genavb.srp
        imply MCUX_COMPONENT_middleware.genavb.hsr
        select MCUX_COMPONENT_component.rtos_apps.tsn_headers

    config MCUX_PRJSEG_config.board.app_bridge_hybrid
        bool "TSN bridge hybrid configuration"
        select APP_TSN_ENDPOINT
        select APP_TSN_BRIDGE
        select APP_STORAGE
        imply APP_QBV
        imply APP_FP
        imply APP_LWIP
        select MCUX_COMPONENT_driver.cache_xcache
        select MCUX_COMPONENT_middleware.freertos-kernel.cm33_non_trustzone

endchoice
```

## boards/evkmimxrt1180/demo_apps/avb_tsn/tsn_app/cm7/Kconfig
```kconfig
# Copyright 2025 NXP
#
# SPDX-License-Identifier: BSD-3-Clause

choice MCUX_PRJSEG_config.board.build_cfg_sel
    prompt "MIMXRT1180 EVK CM7 TSN configuration options"
    default MCUX_PRJSEG_config.board.app_default

    config MCUX_PRJSEG_config.board.app_default
        bool "TSN application Endpoint default configuration"
        select APP_TSN_ENDPOINT
        select APP_USER_BUTTON
        select MCUX_COMPONENT_driver.xbar_1

    config MCUX_PRJSEG_config.board.app_enetc0
        bool "TSN application Endpoint enable enetc0 configuration"
        select APP_TSN_ENDPOINT
        select APP_USER_BUTTON
        select MCUX_COMPONENT_driver.xbar_1

endchoice

config MCUX_PRJSEG_config.board.tsn_motor_controller
    bool "MIMXRT1180 EVK CM7 TSN Motor Controller configuration"
    default n
    select APP_MOTOR_CONTROLLER

config MCUX_PRJSEG_config.board.tsn_motor_iodevice
    bool "MIMXRT1180 EVK CM7 TSN Motor IO-device configuration"
    default n
    select APP_MOTOR_IO_DEVICE
    select APP_LWIP
```

## boards/frdmimxrt1186/demo_apps/avb_tsn/Kconfig.common_deps
```kconfig
config MCUX_PRJSEG_module.board.frdmimxrt1186
    bool
    default y
    select MCUX_COMPONENT_component.phyrtl8201
    select MCUX_COMPONENT_component.phyyt8521
    select MCUX_COMPONENT_driver.msgintr
    select MCUX_COMPONENT_driver.netc
    select MCUX_COMPONENT_driver.netc_switch
    select MCUX_COMPONENT_driver.rgpio
    select MCUX_COMPONENT_driver.trdc
    select MCUX_COMPONENT_driver.flexspi
    select MCUX_COMPONENT_component.rtos_apps.async
```

## boards/frdmimxrt1186/demo_apps/avb_tsn/tsn_app/cm33/Kconfig
```kconfig
# Copyright 2025 NXP
#
# SPDX-License-Identifier: BSD-3-Clause

choice MCUX_PRJSEG_config.board.build_cfg_sel
    prompt "FRDMIMXRT1186 EVK CM33 TSN build configuration options"
    default MCUX_PRJSEG_config.board.app_bridge_default

    config MCUX_PRJSEG_config.board.app_bridge_default
        bool "TSN bridge default configuration"
        select APP_TSN_BRIDGE
        imply APP_STORAGE
        imply APP_QBV
        imply APP_FP
        imply APP_LWIP
        select MCUX_COMPONENT_driver.cache_xcache
        select MCUX_COMPONENT_middleware.freertos-kernel.cm33_non_trustzone
        select MCUX_COMPONENT_middleware.genavb.srp
        select MCUX_COMPONENT_middleware.genavb.hsr
        select MCUX_COMPONENT_component.rtos_apps.tsn_headers

    config MCUX_PRJSEG_config.board.app_bridge_hybrid
        bool "TSN bridge hybrid configuration"
        select APP_TSN_ENDPOINT
        select APP_TSN_BRIDGE
        imply APP_STORAGE
        imply APP_QBV
        imply APP_FP
        imply APP_LWIP
        select MCUX_COMPONENT_driver.cache_xcache
        select MCUX_COMPONENT_middleware.freertos-kernel.cm33_non_trustzone

endchoice

config MCUX_PRJSEG_config.board.tsn_motor_controller
    bool "MIMXRT1186 EVK CM33 TSN Hybrid Motor Controller configuration"
    default n
    select APP_MOTOR_CONTROLLER
```

## boards/frdmimxrt1186/demo_apps/avb_tsn/tsn_app/cm7/Kconfig
```kconfig
# Copyright 2025 NXP
#
# SPDX-License-Identifier: BSD-3-Clause

choice MCUX_PRJSEG_config.board.build_cfg_sel
    prompt "FRDMIMXRT1186 EVK CM7 TSN configuration options"
    default MCUX_PRJSEG_config.board.app_default

    config MCUX_PRJSEG_config.board.app_default
        bool "TSN application Endpoint default configuration"
        select APP_TSN_ENDPOINT
        select APP_USER_BUTTON
        select MCUX_COMPONENT_driver.xbar_1

endchoice

config MCUX_PRJSEG_config.board.tsn_motor_controller
    bool "FRDMIMXRT1186 EVK CM7 TSN Motor Controller configuration"
    default n
    select APP_MOTOR_CONTROLLER

config MCUX_PRJSEG_config.board.tsn_motor_iodevice
    bool "FRDMIMXRT1186 EVK CM7 TSN Motor IO-device configuration"
    default n
    select APP_MOTOR_IO_DEVICE
    select APP_LWIP
```

## boards/frdmmcxe247/demo_apps/avb_tsn/Kconfig.common_deps
```kconfig
# Copyright 2025 NXP
#
# SPDX License Identifier: BSD-3-Clause

config MCUX_PRJSEG_module.board.frdmmcxe247
    bool
    default y
    select MCUX_COMPONENT_component.phylan8741
    select MCUX_COMPONENT_component.rtos_apps.async
    select MCUX_COMPONENT_driver.cache_lmem
    select MCUX_COMPONENT_driver.enet
    select MCUX_COMPONENT_driver.qspi
    select MCUX_COMPONENT_driver.smc
```

## boards/frdmmcxe247/demo_apps/avb_tsn/tsn_app/Kconfig
```kconfig
# Copyright 2025 NXP
#
# SPDX License Identifier: BSD-3-Clause

rsource "../Kconfig.common_deps"

config MCUX_PRJSEG_config.board.tsn
    bool "MCXE247 FRDM endpoint configuration"
    default y
    select APP_LWIP
    select MCUX_COMPONENT_component.rtos_apps.tsn_headers
```

## boards/frdmmcxe31b/demo_apps/avb_tsn/tsn_app/Kconfig
```kconfig
# Copyright 2025-2026 NXP
#
# SPDX License Identifier: BSD-3-Clause

rsource "../Kconfig.common_deps"

config MCUX_PRJSEG_config.board.tsn
    bool "MCXE31B FRDM TSN endpoint configuration"
    default y
    imply APP_LWIP
    select APP_TSN_ENDPOINT
    imply APP_USER_BUTTON
    select APP_QBV
    select APP_FP
    select MCUX_COMPONENT_middleware.genavb.srp

config MCUX_PRJSEG_config.board.tsn_motor_controller
    bool "MCXE31B FRDM TSN Motor Controller configuration"
    default n
    select APP_MOTOR_CONTROLLER

config MCUX_PRJSEG_config.board.tsn_motor_iodevice
    bool "MCXE31B FRDM TSN Motor IO-device configuration"
    default n
    select APP_MOTOR_IO_DEVICE
```

## boards/frdmmcxe32b/demo_apps/avb_tsn/Kconfig.common_deps
```kconfig
# Copyright 2026 NXP
#
# SPDX License Identifier: BSD-3-Clause

config MCUX_PRJSEG_module.board.frdmmcxe32b
    bool
    default y
    select MCUX_COMPONENT_component.phylan8741
    select MCUX_COMPONENT_component.rtos_apps.async
    select MCUX_COMPONENT_driver.qspi
    select MCUX_COMPONENT_driver.enet_qos
```

## boards/frdmmcxe32b/demo_apps/avb_tsn/tsn_app/Kconfig
```kconfig
# Copyright 2026 NXP
#
# SPDX-License-Identifier: BSD-3-Clause

rsource "./${core_id}/Kconfig"
rsource "../Kconfig.common_deps"
```

## boards/src/demo_apps/avb_tsn/audio_app/Kconfig
```kconfig
# Copyright 2025 NXP
#
# SPDX-License-Identifier: BSD-3-Clause

menu "GenAVB/TSN Application Configuration"

config MCUX_PRJSEG_config.board.audio_app
    bool
    default y
    select APP_MCR
    select APP_LWIP
    select APP_STORAGE
    select MCUX_COMPONENT_component.i2c_adapter_interface
    select MCUX_COMPONENT_component.rtos_apps.audio
    select MCUX_COMPONENT_component.rtos_apps.audio.genavb
    select MCUX_COMPONENT_component.rtos_apps.tsn_headers
    select MCUX_COMPONENT_driver.dmamux
    select MCUX_COMPONENT_driver.edma
    select MCUX_COMPONENT_driver.lpi2c
    select MCUX_COMPONENT_driver.sai
    select MCUX_COMPONENT_middleware.genavb.apps.aem_manager
    select MCUX_COMPONENT_middleware.genavb.avtp
    select MCUX_COMPONENT_middleware.genavb.avdecc

config APP_MCR
    bool "Application Board Media Clock Recovery support"
    default n

rsource "../common/Kconfig"
rsource "../common/Kconfig.prjseg"
source "$(app_root_path)/boards/${board}/demo_apps/avb_tsn/Kconfig.common_deps"
endmenu

source "${SdkRootDirPath}/Kconfig.mcuxpresso"
```

## boards/src/demo_apps/avb_tsn/avb_audio_app/Kconfig
```kconfig
# Copyright 2025 NXP
#
# SPDX-License-Identifier: BSD-3-Clause

menu "GenAVB/TSN Application Configuration"
config MCUX_PRJSEG_config.board.avb_audio_app
    bool
    default y
    select APP_MCR
    select APP_LWIP
    select APP_STORAGE
    select MCUX_COMPONENT_component.rtos_apps.async
    select MCUX_COMPONENT_component.rtos_apps.log
    select MCUX_COMPONENT_component.rtos_apps.tsn_headers
    select MCUX_COMPONENT_driver.dmamux
    select MCUX_COMPONENT_driver.edma
    select MCUX_COMPONENT_driver.lpi2c
    select MCUX_COMPONENT_driver.sai
    select MCUX_COMPONENT_middleware.genavb.avdecc
    select MCUX_COMPONENT_middleware.genavb.avtp

config APP_MCR
    bool "Application Board Media Clock Recovery support"
    default n

rsource "../common/Kconfig"
rsource "../common/Kconfig.prjseg"
source "$(app_root_path)/boards/${board}/demo_apps/avb_tsn/Kconfig.common_deps"
endmenu

source "${SdkRootDirPath}/Kconfig.mcuxpresso"
```

## boards/src/demo_apps/avb_tsn/common/Kconfig
```kconfig
# Copyright 2025-2026 NXP
#
# SPDX-License-Identifier: BSD-3-Clause

menu "GenAVB/TSN application common configuration"

config MCUX_PRJSEG_config.board.src_common_files
    bool
    default y

config MCUX_PRJSEG_config.board.app_storage
    bool
    default y if APP_STORAGE
    select MCUX_COMPONENT_middleware.littlefs
    # MCXE3X keeps the file system in on-chip flash (no external QSPI), so pull
    # in the SDK mflash on-chip component that the MCXE lfs backend builds on.
    select MCUX_COMPONENT_component.mflash_onchip if (MCUX_HW_DEVICE_ID_MCXE31B || MCUX_HW_DEVICE_ID_MCXE32B)

config MCUX_PRJSEG_config.board.app_tsn_bridge
    bool
    default y if APP_TSN_BRIDGE
    select MCUX_COMPONENT_component.rtos_apps.shell.tsn_bridge

config APP_LWIP
    bool "lwIP stack support"
    default n
    select MCUX_COMPONENT_middleware.lwip
    select MCUX_COMPONENT_middleware.lwip.apps.lwiperf
    select MCUX_COMPONENT_middleware.lwip.empty_ethernetif

config APP_STORAGE
    bool "Storage support"
    default n
    select MCUX_COMPONENT_component.rtos_apps.storage_common

config APP_QBV
    bool "Scheduled Traffic support"
    default n
    select MCUX_COMPONENT_component.rtos_apps.shell.qbv

config APP_FP
    bool "Frame Preemption support"
    default n
    select MCUX_COMPONENT_component.rtos_apps.shell.fp

config APP_PPS
    bool "PPS output support"
    default y
    depends on ((MCUX_HW_DEVICE_ID_MIMXRT1176xxxxx && MCUX_HW_CORE_CM7F) && !APP_MOTOR_IO_DEVICE)

config APP_TSN_BRIDGE
    bool "TSN Bridge support"
    default n

config APP_MOTOR_CONTROLLER
    bool "Motor Controller support"
    default n
    depends on ((MCUX_HW_DEVICE_ID_MIMXRT1189xxxxx && MCUX_HW_CORE_CM7F) || (MCUX_HW_DEVICE_ID_MIMXRT1176xxxxx && MCUX_HW_CORE_CM7F) || (MCUX_HW_DEVICE_ID_MCXE31B) || (MCUX_HW_DEVICE_ID_MCXE32B && MCUX_HW_CORE_ID_CORE0))

config APP_MOTOR_IO_DEVICE
    bool "Motor IO-device support"
    default n
    depends on ((MCUX_HW_DEVICE_ID_MIMXRT1189xxxxx && MCUX_HW_CORE_CM7F) || (MCUX_HW_DEVICE_ID_MIMXRT1176xxxxx && MCUX_HW_CORE_CM7F) || (MCUX_HW_DEVICE_ID_MCXE31B) || (MCUX_HW_DEVICE_ID_MCXE32B && MCUX_HW_CORE_ID_CORE0))

config APP_MOTOR_ENCODER_ABS_POSITION
    bool "Motor Absolute Position Encoder support"
    default y
    depends on APP_MOTOR_IO_DEVICE
endmenu

rsource "./iar/Kconfig"
source "${SdkRootDirPath}/components/rtos-apps/Kconfig.mcux"
source "${SdkRootDirPath}/components/rtos-abstraction-layer/freertos/Kconfig"
source "${SdkRootDirPath}/middleware/gen_avb/Kconfig"
```
