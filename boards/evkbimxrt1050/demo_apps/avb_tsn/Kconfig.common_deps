## boards/src/demo_apps/avb_tsn/common/Kconfig.prjseg
```kconfig
# Copyright 2025 NXP
#
# SPDX License Identifier: BSD-3-Clause

menu "GenAVB/TSN applications board configuration"

config MCUX_PRJSEG_module.board.avbtsn_default_board_files
    bool
    default y if MCUX_HW_DEVICE_ID_MIMXRT1052xxxxB ||\
    MCUX_HW_DEVICE_ID_MCXE31B ||\
    MCUX_HW_DEVICE_ID_MCXE247

config MCUX_PRJSEG_module.board.avbtsn_default_coreid_board_files
    bool
    default y if MCUX_HW_DEVICE_ID_MIMXRT1189xxxxx || MCUX_HW_DEVICE_ID_MIMXRT1186xxxxx || MCUX_HW_DEVICE_ID_MIMXRT1176xxxxx 

config MCUX_PRJSEG_module.board.avbtsn_default_genavb_sdk_files
    bool
    default y if MCUX_HW_DEVICE_ID_MIMXRT1176xxxxx ||\
    MCUX_HW_DEVICE_ID_MIMXRT1052xxxxB ||\
    MCUX_HW_DEVICE_ID_MCXE31B ||\
    MCUX_HW_DEVICE_ID_MCXE247

config MCUX_PRJSEG_module.board.avbtsn_rt118x_default_device_files
    bool
    default y if MCUX_HW_DEVICE_ID_MIMXRT1189xxxxx || MCUX_HW_DEVICE_ID_MIMXRT1186xxxxx

config MCUX_PRJSEG_module.board.avbtsn_rt118x_device_default_genavb_sdk_files
    bool
    default y if MCUX_HW_DEVICE_ID_MIMXRT1189xxxxx || MCUX_HW_DEVICE_ID_MIMXRT1186xxxxx

config MCUX_PRJSEG_module.board.avbtsn_default_startup_files
    bool
    default y if MCUX_HW_DEVICE_ID_MIMXRT1189xxxxx ||\
    MCUX_HW_DEVICE_ID_MIMXRT1186xxxxx ||\
    MCUX_HW_DEVICE_ID_MIMXRT1176xxxxx ||\
    MCUX_HW_DEVICE_ID_MIMXRT1052xxxxB ||\
    MCUX_HW_DEVICE_ID_MCXE31B ||\
    MCUX_HW_DEVICE_ID_MCXE247

endmenu
```

## boards/src/demo_apps/avb_tsn/common/iar/Kconfig
```kconfig
# Copyright 2025 NXP
#
# SPDX-License-Identifier: BSD-3-Clause

config MCUX_PRJSEG_module.board.iar_stubs
    bool "Stubs for IAR toolchain support"
    default n
```

## boards/src/demo_apps/avb_tsn/dsa/dsa_enetc/Kconfig
```kconfig
# Copyright 2025-2026 NXP
#
# SPDX-License-Identifier: BSD-3-Clause

menu "GenAVB/TSN DSA Enetc Application Configuration"
config MCUX_PRJSEG_config.board.dsa
    bool
    default y
    select APP_QBV
    select APP_FP
    select APP_STORAGE
    select APP_TSN_BRIDGE
    select MCUX_COMPONENT_driver.lpspi
    select MCUX_PRJSEG_module.hmc.virtual_sw_lib
    select MCUX_COMPONENT_component.rtos_apps.tsn_headers
    select MCUX_COMPONENT_middleware.genavb.dsa if MCUX_COMPONENT_middleware.genavb

rsource "../../common/Kconfig"
rsource "../../common/Kconfig.prjseg"

source "${SdkRootDirPath}/middleware/heterogeneous-multicore/net/boards/evkmimxrt1180/cm33/mcux/Kconfig"
source "${SdkRootDirPath}/${board_root}/${board}/demo_apps/avb_tsn/dsa_enetc/Kconfig"
endmenu

source "${SdkRootDirPath}/Kconfig.mcuxpresso"
```

## boards/src/demo_apps/avb_tsn/tsn_app/Kconfig
```kconfig
# Copyright 2025-2026 NXP
#
# SPDX-License-Identifier: BSD-3-Clause

menu "GenAVB/TSN TSN App configuration"
config MCUX_PRJSEG_config.board.tsn_app
    bool
    default y

config MCUX_PRJSEG_config.board.app_tsn_endpoint
    bool
    default y if APP_TSN_ENDPOINT
    select MCUX_COMPONENT_component.rtos_apps.tsn
    select MCUX_COMPONENT_component.rtos_apps.tsn.lwip if APP_LWIP
    select APP_USER_BUTTON if ((MCUX_HW_DEVICE_ID_MIMXRT1189xxxxx || MCUX_HW_DEVICE_ID_MIMXRT1176xxxxx) && MCUX_HW_CORE_CM7F)

config APP_TSN_ENDPOINT
    bool "TSN Endpoint support"
    default n

config APP_USER_BUTTON
    bool "User Button support"
    default n
    select MCUX_COMPONENT_component.rtos_apps.user_button

config APP_SERIAL
    bool "Serial support"
    default n
    select MCUX_COMPONENT_component.rtos_apps.serial

config MCUX_PRJSEG_config.board.app_motor_iodevice
    bool
    default y if APP_MOTOR_IO_DEVICE
    select MCUX_COMPONENT_component.rtos_apps.tsn.motor.iodevice
    select MCUX_COMPONENT_middleware.rtcesl.cm7f
    select MCUX_COMPONENT_driver.lpadc if (MCUX_HW_DEVICE_ID_MIMXRT1189xxxxx || MCUX_HW_DEVICE_ID_MIMXRT1176xxxxx) && MCUX_HW_CORE_CM7F
    select MCUX_COMPONENT_driver.eqdc if MCUX_HW_DEVICE_ID_MIMXRT1189xxxxx && MCUX_HW_CORE_CM7F
    select MCUX_COMPONENT_driver.xbar_1 if MCUX_HW_DEVICE_ID_MIMXRT1189xxxxx && MCUX_HW_CORE_CM7F
    select MCUX_COMPONENT_middleware.motor_control.mc_drivers_adcimxrt1180_pwma_enc if MCUX_HW_DEVICE_ID_MIMXRT1189xxxxx && MCUX_HW_CORE_CM7F
    select MCUX_COMPONENT_middleware.mc_pmsm_enc.float if (MCUX_HW_DEVICE_ID_MIMXRT1189xxxxx || MCUX_HW_DEVICE_ID_MIMXRT1176xxxxx) && MCUX_HW_CORE_CM7F || MCUX_HW_DEVICE_ID_MCXE31B 
    select MCUX_COMPONENT_driver.enc if MCUX_HW_DEVICE_ID_MIMXRT1176xxxxx && MCUX_HW_CORE_CM7F
    select MCUX_COMPONENT_driver.xbara if MCUX_HW_DEVICE_ID_MIMXRT1176xxxxx && MCUX_HW_CORE_CM7F
    select MCUX_COMPONENT_driver.adc_etc if MCUX_HW_DEVICE_ID_MIMXRT1176xxxxx && MCUX_HW_CORE_CM7F
    select MCUX_COMPONENT_driver.acmp if MCUX_HW_DEVICE_ID_MIMXRT1176xxxxx && MCUX_HW_CORE_CM7F
    select MCUX_COMPONENT_middleware.motor_control.mc_drivers_adcimxrt11xx_pwma_enc if MCUX_HW_DEVICE_ID_MIMXRT1176xxxxx && MCUX_HW_CORE_CM7F
    select MCUX_COMPONENT_driver.pit if MCUX_HW_DEVICE_ID_MCXE31B
    select MCUX_COMPONENT_driver.sar_adc if MCUX_HW_DEVICE_ID_MCXE31B
    select MCUX_COMPONENT_driver.trgmux if MCUX_HW_DEVICE_ID_MCXE31B
    select MCUX_COMPONENT_driver.bctu if MCUX_HW_DEVICE_ID_MCXE31B
    select MCUX_COMPONENT_driver.lcu if MCUX_HW_DEVICE_ID_MCXE31B
    select MCUX_COMPONENT_middleware.motor_control.mc_drivers_mcxe3xx if MCUX_HW_DEVICE_ID_MCXE31B

config MCUX_PRJSEG_config.board.app_motor_controller
    bool
    default y if APP_MOTOR_CONTROLLER
    select MCUX_COMPONENT_component.rtos_apps.tsn.motor.controller
    select MCUX_COMPONENT_component.rtos_apps.tsn.lwip if APP_LWIP

rsource "../common/Kconfig"
rsource "../common/Kconfig.prjseg"
source "$(app_root_path)/boards/${board}/demo_apps/avb_tsn/tsn_app/Kconfig"
endmenu

source "${SdkRootDirPath}/Kconfig.mcuxpresso"
```

## west.yml
```yaml
# The west manifest file for Freertos Applications

manifest:
  defaults:
    remote: nxp

  remotes:
    - name: nxp
      url-base: https://github.com/NXP
    - name: nxp-mcuxpresso
      url-base: https://github.com/nxp-mcuxpresso
    - name: nxp-realtimeedge
      url-base: https://github.com/nxp-real-time-edge-sw

  group-filter:
  - -bifrost

  projects:
    - name: mcuxsdk-manifests
      remote: nxp-mcuxpresso
      revision: 5d928e9f4e7ad35d77dec33e8aaa58f165da1558
      import:
        name-allowlist:
          - core
          # NXP configuration layer for freertos kernel
          - freertos-kernel
          # Github upstream freertos kernel repository
          - freertos-kernel-upstream
          - CMSIS
          - mcux-sdk-middleware-sdmmc
          - lwip
          - littlefs
          - mcu-sdk-components
          - mcu-sdk-examples
          - mcu-sdk-examples-int
          - mcux-devices-rt
          - mcux-devices-mcx
          - motor_control
          - rtcesl
          - freemaster
          # include lvgl in order to remove kconfig definition warnings.
          - lvgl
          - mbedtls3x
          - psa_crypto_driver
          - mcuxsdk-tool-data
    - name: GenAVB_TSN
      path: mcuxsdk/middleware/gen_avb
      revision: fe2610ab5cdb6793939fd1408e807c2736cad49c
    - name: rtos-abstraction-layer
      path: mcuxsdk/components/rtos-abstraction-layer
      revision: d7e481b3418238793591838487afc51c53c49eff
    - name: rtos-apps
      path: mcuxsdk/components/rtos-apps
      revision: f5600c990695cf5692eaedb82b4645c88939733b
    - name: heterogeneous-multicore
      remote: nxp-realtimeedge
      path: mcuxsdk/middleware/heterogeneous-multicore
      revision: ac848b3f1cf5abd717e7435f78b485cb6042e776

  self:
    import:
    - submanifests/internal.yml
```
